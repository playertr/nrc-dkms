/dts-v1/;
// dtree overlay for SPI comms.
// Originally produced using /opt/nvidia/jetson-io/jetson-io.py.
// Further modified to disable spi0@0.
/ {
	jetson-header-name = "Jetson 40pin Header";
	overlay-name = "Prepare SPI0 for NRC Driver";
	compatible = "nvidia,p3449-0000-b00+p3448-0000-b00", "nvidia,p3449-0000-a02+p3448-0000-a02";

	fragment@0 {
		target = <0xffffffff>;

		__overlay__ {
			pinctrl-names = "default";
			pinctrl-0 = <0x1>;

			exp-header-pinmux {
				linux,phandle = <0x1>;
				phandle = <0x1>;

				hdr40-pin19 {
					nvidia,pins = "spi1_mosi_pc0";
					nvidia,function = "spi1";
					nvidia,pull = <0x1>;
					nvidia,tristate = <0x0>;
					nvidia,enable-input = <0x1>;
				};

				hdr40-pin21 {
					nvidia,pins = "spi1_miso_pc1";
					nvidia,function = "spi1";
					nvidia,pull = <0x1>;
					nvidia,tristate = <0x0>;
					nvidia,enable-input = <0x1>;
				};

				hdr40-pin23 {
					nvidia,pins = "spi1_sck_pc2";
					nvidia,function = "spi1";
					nvidia,pull = <0x1>;
					nvidia,tristate = <0x0>;
					nvidia,enable-input = <0x1>;
				};

				hdr40-pin24 {
					nvidia,pins = "spi1_cs0_pc3";
					nvidia,function = "spi1";
					nvidia,pull = <0x2>;
					nvidia,tristate = <0x0>;
					nvidia,enable-input = <0x1>;
				};

				hdr40-pin26 {
					nvidia,pins = "spi1_cs1_pc4";
					nvidia,function = "spi1";
					nvidia,pull = <0x2>;
					nvidia,tristate = <0x0>;
					nvidia,enable-input = <0x1>;
				};
			};
		};
	};

	// Initially disable spi0@0 to prevent it being
	// auto-claimed by tegra-spidev.
	fragment@1 {
		target = <0xffffffff>;

		__overlay__ {
			spi@0{
				status = "disabled";
				compatible = "tegra-spidev,nrc-cspi";
			};
		};
	};

	// Remove the SPI pins from being claimed by GPIO
	// fragment@2 {
	// 	target = <0xffffffff>;

	// 	default{
	// 		__overlay__ {
	// 			// https://forums.developer.nvidia.com/t/issues-with-jetson-nano-production-and-jetson-io-and-jetpack-4-6-rev1/186968/19
	// 			// https://forums.developer.nvidia.com/t/tegra-gpio-port-offset/179621
	// 			// SPI pins are TEGRA_GPIO(C, 0) through TEGRA_GPIO(C, 4)
	// 			// which is 16 through 20 or 0x10 through 0x14
	// 			// gpio-input = <0xd8 0xc 0xd 0xe 0xf 0xe8 0x26 0x95 0x5 0xbc 0xbd 0xbe 0xc1 0xc2 0xa8 0xc8 0xca 0x4d 0x4e 0x4c 0x4f 0x32 0x33 /* 0x10 0x11 0x12 0x13 0x14 */ 0x3a 0x3d 0x3e 0x41 0xe4>;
	// 			gpio-input = <0xd8 0xc 0xd 0xe 0xf 0xe8 0x26 0x95 0x5 0xbc 0xbd 0xbe 0xc1 0xc2 0xa8 0xc8 0xca 0x4d 0x4e 0x4c 0x4f 0x32 0x33 0x3a 0x3d 0x3e 0x41 0xe4>;
	// 		};
	// 	};
	// };
	__symbols__ {
		jetson_io_pinmux = "/fragment@0/__overlay__/exp-header-pinmux";
	};

	__fixups__ {
		pinmux = "/fragment@0:target:0";
		spi0 = "/fragment@1:target:0";
		// gpio = "/fragment@2:target:0";
	};

	__local_fixups__ {

		fragment@0 {

			__overlay__ {
				pinctrl-0 = <0x0>;
			};
		};
	};
};
